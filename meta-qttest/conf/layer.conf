## meta-qttest/conf/layer.conf
```bitbake
# We have a conf and classes directory, add to BBPATH
BBPATH .= ":${LAYERDIR}"

# We have recipes-* directories, add to BBFILES
BBFILES += "${LAYERDIR}/recipes-*/*/*.bb \
            ${LAYERDIR}/recipes-*/*/*.bbappend"

BBFILE_COLLECTIONS += "meta-qttest"
BBFILE_PATTERN_meta-qttest = "^${LAYERDIR}/"
BBFILE_PRIORITY_meta-qttest = "6"

LAYERDEPENDS_meta-qttest = "core"
LAYERSERIES_COMPAT_meta-qttest = "kirkstone"
```
